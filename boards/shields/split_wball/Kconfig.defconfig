## boards/shields/split_wball/Kconfig.defconfig
```kconfig
if SHIELD_SPLIT_WBALL_LEFT

config ZMK_KEYBOARD_NAME
    default "split_wball"

config ZMK_SPLIT_ROLE_CENTRAL
    default n

config ZMK_INPUT_PROCESSOR_AUTO_MOUSE_LAYER
    default y

config ZMK_BEHAVIOR_AUTO_MOUSE
    default y

endif

if SHIELD_SPLIT_WBALL_RIGHT

config ZMK_KEYBOARD_NAME
    default "Split WBall"

config ZMK_SPLIT_ROLE_CENTRAL
    default y

config ZMK_INPUT_PROCESSOR_AUTO_MOUSE_LAYER
    default y

config ZMK_BEHAVIOR_AUTO_MOUSE
    default y

endif

if SHIELD_SPLIT_WBALL_LEFT || SHIELD_SPLIT_WBALL_RIGHT

config ZMK_SPLIT
    default y

endif
```

## boards/shields/split_wball/behaviors/Kconfig
```kconfig
# Copyright (c) 2025 The ZMK Contributors
# SPDX-License-Identifier: MIT

config ZMK_BEHAVIOR_AUTO_MOUSE
	bool "Auto Mouse Behavior"
	depends on ZMK_LAYERS
	default y
	help
	  Enable auto mouse behavior that provides manual control and 
	  API for automatic layer switching for mouse functionality.
```

## boards/shields/split_wball/dts/bindings/zmk,behavior-auto-mouse.yaml
```yaml
description: |
  A behavior that manages automatic layer switching for mouse functionality.
  Can be used to manually control auto mouse features or provide an API 
  for input processors.

compatible: "zmk,behavior-auto-mouse"

include: behavior.yaml

properties:
  layer:
    type: int
    required: true
    description: |
      The layer index to activate for mouse functionality.

  timeout-ms:
    type: int
    default: 600
    description: |
      Timeout in milliseconds before automatically returning to the original layer.
      Set to 0 to disable timeout (manual deactivation only).

  enable-on-init:
    type: boolean
    default: true
    description: |
      Whether the auto mouse functionality should be enabled on initialization.

  auto-enable:
    type: boolean
    default: true
    description: |
      Whether the auto mouse should be automatically triggered by input processors.

  "#binding-cells":
    const: 1
```

## boards/shields/split_wball/dts/bindings/zmk,input-processor-auto-mouse-layer.yaml
```yaml
description: |
  An input processor that automatically activates a specific layer when pointing device 
  movement exceeds a threshold, and deactivates it after a timeout period.

compatible: "zmk,input-processor-auto-mouse-layer"

include: input-processor.yaml

properties:
  layer:
    type: int
    required: true
    description: |
      The layer index to activate when movement threshold is exceeded.

  timeout-ms:
    type: int
    default: 600
    description: |
      Timeout in milliseconds before automatically returning to the original layer.
      Set to 0 to disable timeout (manual deactivation only).

  movement-threshold:
    type: int
    default: 100
    description: |
      Total accumulated movement required to trigger layer activation.
      This is the sum of absolute values of X and Y movements.

  require-motion:
    type: boolean
    default: true
    description: |
      Whether to require motion events to activate the layer.
      If false, any input event can trigger activation.
```

## boards/shields/split_wball/input_processors/Kconfig
```kconfig
# Copyright (c) 2025 The ZMK Contributors
# SPDX-License-Identifier: MIT

config ZMK_INPUT_PROCESSOR_AUTO_MOUSE_LAYER
	bool "Auto Mouse Layer Input Processor"
	depends on ZMK_LAYERS
	default y
	help
	  Enable auto mouse layer input processor that automatically 
	  activates a specified layer when pointing device movement 
	  exceeds a configured threshold, and deactivates it after 
	  a timeout period.
```
