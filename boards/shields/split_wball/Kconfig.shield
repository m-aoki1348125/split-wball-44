## boards/shields/split_wball/Kconfig.shield
```kconfig
config SHIELD_SPLIT_WBALL_LEFT
    def_bool $(shields_list_contains,split_wball_left)
config SHIELD_SPLIT_WBALL_RIGHT
    def_bool $(shields_list_contains,split_wball_right)
```

## config/west.yml
```yaml
manifest:
  remotes:
    - name: zmkfirmware
      url-base: https://github.com/zmkfirmware
    - name: m-aoki1348125
      url-base: https://github.com/m-aoki1348125
  projects:
    - name: zmk
      remote: zmkfirmware
      revision: main
      import: app/west.yml
    - name: zmk-driver-paw3222
      remote: m-aoki1348125
      revision: main
  self:
    path: config
```
